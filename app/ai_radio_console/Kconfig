## realprojectnewnow/vendor_allwinnertech/chips/r528/components/multimedia/src/libcedarx/Kconfig
```kconfig
#
# For a description of the syntax of this configuration file,
# see the file kconfig-language.txt in the NuttX tools repository.
#

menu "libcedarx"

config LIBCEDARX
	bool "allwinner libcedarx support"
	default n

config FILE_STREAM_ENABLE
	bool "enable file stream"
	depends on LIBCEDARX
	default y

config HTTP_STREAM_ENABLE
	bool "enable http stream"
	depends on LIBCEDARX
	default n

config ASF_PARSER_ENABLE
	bool "enable asf parser"
	depends on LIBCEDARX
	default n

config AVI_PARSER_ENABLE
	bool "enable avi parser"
	depends on LIBCEDARX
	default y

config FLV_PARSER_ENABLE
	bool "enable flv parser"
	depends on LIBCEDARX
	default y

config TS_PARSER_ENABLE
	bool "enable ts parser"
	depends on LIBCEDARX
	default y

config MKV_PARSER_ENABLE
	bool "enable mkv parser"
	depends on LIBCEDARX
	default y

config MOV_PARSER_ENABLE
	bool "enable mov parser"
	depends on LIBCEDARX
	default y

config MPG_PARSER_ENABLE
	bool "enable mpg parser"
	depends on LIBCEDARX
	default n

config AAC_PARSER_ENABLE
	bool "enable aac parser"
	depends on LIBCEDARX
	default y

config AMR_PARSER_ENABLE
	bool "enable amr parser"
	depends on LIBCEDARX
	default n

config ATRAC_PARSER_ENABLE
	bool "enable atrac parser"
	depends on LIBCEDARX
	default n

config FLAC_PARSER_ENABLE
	bool "enable flac parser"
	depends on LIBCEDARX
	default n

config ID3V2_PARSER_ENABLE
	bool "enable id2v2 parser"
	depends on LIBCEDARX
	default y

config MP3_PARSER_ENABLE
	bool "enable mp3 parser"
	depends on LIBCEDARX
	default y

config OGG_PARSER_ENABLE
	bool "enable ogg parser"
	depends on LIBCEDARX
	default y

config PLS_PARSER_ENABLE
	bool "enable pls parser"
	depends on LIBCEDARX
	default y

config WAV_PARSER_ENABLE
	bool "enable wav parser"
	depends on LIBCEDARX
	default y

config HLS_PARSER_ENABLE
	bool "enable hls parser"
	depends on LIBCEDARX
	default n

config PMP_PARSER_ENABLE
	bool "enable pmp parser"
	depends on LIBCEDARX
	default n

config HTTPS_SUPPORT
	bool "enable https stream"
	depends on LIBCEDARX
	default y

config HTTP_STREAM_SET_PROTECT_AREA_SIZE
	bool "http stream set protect area size"
	depends on LIBCEDARX
	default y

config HTTP_STREAM_SUPPORT_FREE_BUFFER
	bool "http stream support free buffer"
	depends on LIBCEDARX
	default y

config HTTP_STREAM_RECONNECT_RELOAD
	int "http stream reconnect reload"
	depends on LIBCEDARX
	default 1
	
config HTTP_STREAM_IGNORE_DATA_SEEK
	int "http stream ignore data seek"
	depends on LIBCEDARX
	default 1

config HTTP_STREAM_IGNORE_DATA_FAST_SEEK
	int "http stream ignore data fast seek"
	depends on LIBCEDARX
	default 1

config ADEC_CONFIG_COMPILE_STATIC_LIB
	int "adecode use static lib"
	depends on LIBCEDARX
	default 1

config CONFIG_COMPILE_STATIC_LIB
	bool "compile use static lib"
	depends on LIBCEDARX
	default y

config ONLINE_SUPPORT
	int "online support"
	depends on LIBCEDARX
	default 1

config LIVEMODE_VIDEO
	depends on LIBCEDARX
	int "livemode video"
	default 1

config ONLY_DISABLE_AUDIO
	int "disable audio"
	depends on LIBCEDARX
	default 1
endmenu
```

## realprojectnewnow/vendor_allwinnertech/chips/r528/components/rpmsg_memblk/Kconfig
```kconfig
menu "Allwinner rpmsg memblk"

config AW_RPMSG_MEMBLK
	bool "rpmsg memblk comonent"
	default n

config AW_RPMSG_MEMBLK_TEST
	bool "rpmsg memblk test app"
	default n

config AW_RPMSG_MEMBLK_DEBUG
	bool "rpmsg memblk debug info"
	default n

config AW_MEMBLK_DEBUG
	bool "memblk debug info"
	default n

config MEMBLK_MAX_ITEM
	int "memblk max item"
	depends on AW_RPMSG_MEMBLK
	default 32

config AW_RPMSG_MEMBLK_THTEAD_PRIORITY
	int "memblk thread priority"
	depends on AW_RPMSG_MEMBLK
	default 100

config AW_RPMSG_MEMBLK_THTEAD_STACK_SIZE
	int "memblk thread stack size"
	depends on AW_RPMSG_MEMBLK
	default 8192



endmenu
```

## realprojectnewnow/vendor_allwinnertech/chips/r528/components/rpmsg_test/Kconfig
```kconfig
menu "Allwinner rpmsg test"

config AW_RPMSG_TEST
	bool "Enable rpmsg test"
	depends on RPTUN
	default n

config AW_RPMSG_TEST_STACKSIZE
	int "thread stack size(default 4096)"
	depends on AW_RPMSG_TEST
	default 4096

config AW_RPMSG_TEST_PRIORITY
	int "rptun thread priority (default 100)"
	depends on AW_RPMSG_TEST
	default 100

config AW_RPMSG_TEST_QUEUE_LENGTH
	int "recv queue len"
	depends on AW_RPMSG_TEST
	default 4

endmenu
```

## realprojectnewnow/vendor_allwinnertech/chips/r528/drivers/rtos-hal/hal/source/Kconfig
```kconfig
source '../vendor/allwinnertech/chips/r528/drivers/rtos-hal/hal/source/ccmu/Kconfig'
source '../vendor/allwinnertech/chips/r528/drivers/rtos-hal/hal/source/gpio/Kconfig'
source '../vendor/allwinnertech/chips/r528/drivers/rtos-hal/hal/source/dma/Kconfig'
source '../vendor/allwinnertech/chips/r528/drivers/rtos-hal/hal/source/spi/Kconfig'
source '../vendor/allwinnertech/chips/r528/drivers/rtos-hal/hal/source/uart/Kconfig'
source '../vendor/allwinnertech/chips/r528/drivers/rtos-hal/hal/source/nand_flash/Kconfig'
source '../vendor/allwinnertech/chips/r528/drivers/rtos-hal/hal/source/rtc/Kconfig'
source '../vendor/allwinnertech/chips/r528/drivers/rtos-hal/hal/source/disp2/Kconfig'
source '../vendor/allwinnertech/chips/r528/drivers/rtos-hal/hal/source/g2d_rcq/Kconfig'
source '../vendor/allwinnertech/chips/r528/drivers/rtos-hal/hal/source/pwm/Kconfig'
source '../vendor/allwinnertech/chips/r528/drivers/rtos-hal/hal/source/sdmmc/Kconfig'
source '../vendor/allwinnertech/chips/r528/drivers/rtos-hal/hal/source/timer/Kconfig'
source '../vendor/allwinnertech/chips/r528/drivers/rtos-hal/hal/source/gpadc/Kconfig'
source '../vendor/allwinnertech/chips/r528/drivers/rtos-hal/hal/source/lradc/Kconfig'
source '../vendor/allwinnertech/chips/r528/drivers/rtos-hal/hal/source/tpadc/Kconfig'
source '../vendor/allwinnertech/chips/r528/drivers/rtos-hal/hal/source/msgbox/Kconfig'
source '../vendor/allwinnertech/chips/r528/drivers/rtos-hal/hal/source/efuse/Kconfig'
source '../vendor/allwinnertech/chips/r528/drivers/rtos-hal/hal/source/sound/Kconfig'
source '../vendor/allwinnertech/chips/r528/drivers/rtos-hal/hal/source/twi/Kconfig'
source '../vendor/allwinnertech/chips/r528/drivers/rtos-hal/hal/source/input/Kconfig'
source '../vendor/allwinnertech/chips/r528/drivers/rtos-hal/hal/source/usb/Kconfig'
source '../vendor/allwinnertech/chips/r528/drivers/rtos-hal/hal/source/sensor/Kconfig'
source '../vendor/allwinnertech/chips/r528/drivers/rtos-hal/hal/source/ce/Kconfig'
source '../vendor/allwinnertech/chips/r528/drivers/rtos-hal/hal/source/hwspinlock/Kconfig'
source '../vendor/allwinnertech/chips/r528/drivers/rtos-hal/hal/source/ledc/Kconfig'
source '../vendor/allwinnertech/chips/r528/drivers/rtos-hal/hal/source/cir_rx/Kconfig'
source '../vendor/allwinnertech/chips/r528/drivers/rtos-hal/hal/source/cir_tx/Kconfig'
```

## realprojectnewnow/vendor_allwinnertech/chips/r528/drivers/rtos-hal/hal/source/ce/Kconfig
```kconfig
menu "CE Devices"

config DRIVERS_CE
    bool "enable ce driver"
    select ARCH_HAVE_RNG
        default y

config HAL_TEST_CE
    bool "enable ce hal APIs test command"
	depends on DRIVERS_CE
        default n


endmenu
```

## realprojectnewnow/vendor_allwinnertech/chips/r528/drivers/rtos-hal/hal/source/gpadc/Kconfig
```kconfig
menu "GPADC Devices"

config DRIVERS_GPADC
	bool "enable gpadc driver"
	default n

config DRIVERS_GPADC_CTL_NUM
	int "DRIVERS_GPADC_CTL_NUM"
	depends on DRIVERS_GPADC
	default 0
	range 0 2
	---help---
		Select the GPADC controller to use
		On the R528, there is currently only one GPADC controller
		There are two sets of channels inside a control


config HAL_TEST_GPADC
	bool "enable gpadc hal APIs test command"
	depends on DRIVERS_GPADC
		default n

endmenu
```

## realprojectnewnow/vendor_allwinnertech/chips/r528/drivers/rtos-hal/hal/source/gpio/Kconfig
```kconfig
menu "GPIO Devices"

config DRIVERS_GPIO
    bool "enable gpio driver"
        default n

config DRIVERS_GPIO_IOEXPANDER_INTERRUPT
    bool "support nuttx ioexpander interrupt"
    default n
	select IOEXPANDER_INT_ENABLE

config HAL_TEST_GPIO
    bool "enable gpio hal APIs test command"
	depends on DRIVERS_GPIO
        default n

config DRIVERS_GPIO_SHARE_IRQ
    bool "enable amp gpio irq"
        default n

endmenu
```
