## app/ai_radio_console/Kconfig
```kconfig
#
# For a description of the syntax of this configuration file,
# see the file kconfig-language.txt in the NuttX tools repository.
#

config LVX_USE_DEMO_CONTEST2026_095_AI_RADIO_CONSOLE
	bool "Contest 2026 team 095 AI Radio Console (DayNote)"
	default n
	depends on GRAPHICS_LVGL
	depends on LV_USE_NUTTX
	depends on EXAMPLES_AI_AGENT_VELA || VELACLAW_DAEMON
	select NETUTILS_CJSON
	---help---
		AI Radio Console (project codename DayNote) for Gemini-S1
		(Allwinner R528). Voice memo recording with VAD/PTT, SiliconFlow
		ASR, LLM summary/keywords through the VelaClaw ai_agent framework,
		a five-page LVGL UI on the ILI9341 LCD, BLE Wi-Fi provisioning and
		an MMDVM/DMR network hotspot client.

if LVX_USE_DEMO_CONTEST2026_095_AI_RADIO_CONSOLE

config DAYNOTE_DATA_DIR
	string "DayNote data directory"
	default "/data/daynote"

config DAYNOTE_REVIEW_INTERVAL
	int "Default periodic review interval (seconds)"
	default 14400

endif
```

## realprojectnewnow/vendor_allwinnertech/apps/ai_radio_console/Kconfig
```kconfig
#
# Copyright (C) 2026 Xiaomi Corporation
#
# Licensed under the Apache License, Version 2.0 (the "License");
# you may not use this file except in compliance with the License.
# You may obtain a copy of the License at
#
#      http://www.apache.org/licenses/LICENSE-2.0
#
# Unless required by applicable law or agreed to in writing, software
# distributed under the License is distributed on an "AS IS" BASIS,
# WITHOUT WARRANTIES OR CONDITIONS OF ANY KIND, either express or implied.
# See the License for the specific language governing permissions and limitations
# under the License.
#

config AI_RADIO_CONSOLE
	bool "AI Radio Console (Gemini-S1 HAT)"
	default n
	depends on AUDIO && LVGL && EXAMPLES_AI_AGENT_VELA
	---help---
		AI Radio Console for Gemini-S1 with AI Radio HAT.
		Provides LVGL UI, LINEIN audio recording, PTT control,
		ASR transcription and ai_agent integration for radio QSO logging.

if AI_RADIO_CONSOLE

config AI_RADIO_CONSOLE_USE_VOICE_CHANNEL
	bool "Use ai_agent voice_channel for PTT+ASR"
	default y
	depends on EXAMPLES_AI_AGENT_VELA
	---help---
		Use the ai_agent voice_channel API (voice_channel_start /
		voice_channel_stop_with_text) for PTT recording and ASR.
		This is the recommended path in the mini_memo example:
		ai_agent handles capture, streaming/batch ASR and HTTPS.
		
		If disabled, fall back to the legacy nxrecorder + custom
		HTTP ASR client path (requires an HTTP relay for HTTPS).

config AI_RADIO_CONSOLE_PTT_SELFTEST_MS
	int "PTT selftest hold time (ms, 0=disabled)"
	default 0
	---help---
		If non-zero, the application starts in PTT self-test mode
		and simulates a PTT press of this duration at startup.
		Useful for headless testing (e.g. mini_memo --ptt-selftest).

config AI_RADIO_CONSOLE_PRIORITY
	int "ai_radio_console task priority"
	default 100

config AI_RADIO_CONSOLE_STACKSIZE
	int "ai_radio_console task stack size"
	default 8192

config AI_RADIO_CONSOLE_PTT_GPIO
	string "PTT GPIO device path"
	default "/dev/gpio0"
	---help---
		GPIO device used for PTT keying (e.g., /dev/gpio0).

config AI_RADIO_CONSOLE_PTT_PIN
	int "PTT GPIO pin number"
	default 0
	---help---
		Pin number on the GPIO device for PTT (GPADC0 -> 0).

config AI_RADIO_CONSOLE_INPUT_DEV
	string "LVGL input/touch device path"
	default "/dev/input0"
	---help---
		Touchscreen or button input device used by LVGL (e.g. /dev/input0).
		Leave empty if the board has no touchscreen.

if !AI_RADIO_CONSOLE_USE_VOICE_CHANNEL

config AI_RADIO_CONSOLE_AUDIO_DEV
	string "Audio capture device"
	default "/dev/audio/pcm0c"
	---help---
		PCM capture device used by the legacy nxrecorder backend.
		Ignored when voice_channel is enabled.

config AI_RADIO_CONSOLE_ASR_URL
	string "ASR API URL"
	default "https://api.siliconflow.cn/v1/audio/transcriptions"
	---help---
		HTTP ASR endpoint for the legacy nxrecorder + custom ASR path.
		Ignored when voice_channel is enabled (ai_agent config owns ASR).

config AI_RADIO_CONSOLE_ASR_MODEL
	string "ASR model name"
	default "iic/SenseVoiceSmall"
	---help---
		ASR model for the legacy nxrecorder + custom ASR path.
		Ignored when voice_channel is enabled.

endif # !AI_RADIO_CONSOLE_USE_VOICE_CHANNEL

config AI_RADIO_CONSOLE_SERVER
	bool "Enable built-in REST/WebSocket server"
	default y
	---help---
		Start a small HTTP/WebSocket server inside ai_radio_console.
		Default port is 28790 to avoid conflict with ai_agent on 28789.

config AI_RADIO_CONSOLE_SERVER_PORT
	int "REST/WebSocket server port"
	default 28790
	depends on AI_RADIO_CONSOLE_SERVER

endif
```

## realprojectnewnow/vendor_allwinnertech/apps/ltr553/Kconfig
```kconfig
#
# For a description of the syntax of this configuration file,
# see the file kconfig-language.txt in the NuttX tools repository.
#

config EXAMPLES_LTR553
	bool "LTR553 light and proximity sensor uORB test example"
	default n
	depends on SENSORS_LTR553 && UORB
	---help---
		Enable the LTR553 light and proximity sensor uORB test example.
		This example demonstrates how to use uORB subscription to read
		sensor data from LTR553 light and proximity sensors.

if EXAMPLES_LTR553

config EXAMPLES_LTR553_PROGNAME
	string "Program name"
	default "ltr553_uorb"
	---help---
		This is the name of the program that will be used when the NSH ELF
		program is installed.

config EXAMPLES_LTR553_PRIORITY
	int "LTR553 test task priority"
	default 100
	---help---
		Priority of the LTR553 test task.

config EXAMPLES_LTR553_STACKSIZE
	int "LTR553 test stack size"
	default DEFAULT_TASK_STACKSIZE
	---help---
		Stack size needed by the LTR553 test task.

endif
```

## realprojectnewnow/vendor_allwinnertech/apps/t070s140b_touch_test/Kconfig
```kconfig
#
# For a description of the syntax of this configuration file,
# see the file kconfig-language.txt in the NuttX tools repository.
#

config EXAMPLES_T070S140B_TOUCH_TEST
	bool "T070S140B LCD IIC Touchscreen Test Application"
	default n
	depends on GT911_IIC_TOUCH
	---help---
		Enable the T070S140B LCD IIC touchscreen test application.
		This application tests the T070S140B touchscreen functionality
		by reading touch events and displaying touch coordinates with
		percentage positions relative to the 1024x600 LCD screen.

if EXAMPLES_T070S140B_TOUCH_TEST

config EXAMPLES_T070S140B_TOUCH_TEST_PROGNAME
	string "T070S140B touch test program name"
	default "t070s140b_touch_test"
	---help---
		This is the name of the program that will be used when the NSH ELF
		program is installed.

config EXAMPLES_T070S140B_TOUCH_TEST_PRIORITY
	int "T070S140B touch test task priority"
	default 100

config EXAMPLES_T070S140B_TOUCH_TEST_STACKSIZE
	int "T070S140B touch test stack size"
	default DEFAULT_TASK_STACKSIZE

endif # EXAMPLES_T070S140B_TOUCH_TEST
```

## realprojectnewnow/vendor_allwinnertech/boards/r528/drivers/realtek_ieee80211/Kconfig
```kconfig
#
# For a description of the syntax of this configuration file,
# see the file kconfig-language.txt in the NuttX tools repository.
#

config IEEE80211_REALTEK_WIFI
	bool "Realtek wifi chip support"
	depends on DRIVERS_IEEE80211
	default n
	select CRYPTO_MBEDTLS
	select MBEDTLS_SSL_PROTO_DTLS
	select MBEDTLS_PLATFORM_MEMORY

config USER_WIFIMAC
	bool "Realtek wifi config use user MAC"
	depends on IEEE80211_REALTEK_WIFI
	default n

if USER_WIFIMAC
config USER_WIFIMAC_PATH
	string "Realtek wifi Configure MAC File Path"
	default "/data/wifi/wifimac.txt"

endif

config USER_PHY_REG_PG
	bool "Realtek wifi config use user PHY_REG_PG"
	depends on IEEE80211_REALTEK_WIFI
	default n

if USER_PHY_REG_PG
config USER_PHY_REG_PG_PATH
	string "Realtek wifi Configure PHY_REG_PG File Path"
	default "/data/PHY_REG_PG.txt"
endif

config EFUSE_CONFIG_FILE
	bool "Realtek wifi config use user efuse map"
	depends on IEEE80211_REALTEK_WIFI
	default n

if EFUSE_CONFIG_FILE
config EFUSE_MAP_PATH
	string "Realtek wifi Configure user efuse map File Path"
	default "/etc/wifi_factest/rtl8733bs_wifi.map"
endif


config CCV_WIFI_FW_PATH
	string "Realtek wifi Configure user efuse map File Path"
	default "/resource/etc/wifi/FW_NIC_ACUT.bin"

config WIFI_FW_PATH
	string "Realtek wifi Configure user efuse map File Path"
	default "/resource/etc/wifi/FW_NIC_BCUT.bin"

config IEEE80211_REALTEK_WIFI_RTL8733BS
	bool "Realtek wifi rtl8733bs chip support"
	depends on IEEE80211_REALTEK_WIFI
	default n

config WIFI_STATISTICS
	bool "wifi link statistics"
	depends on IEEE80211_REALTEK_WIFI
	default n

if WIFI_STATISTICS
config WIFI_STATISTICS_PERIOD
	int "wifi link statistics period (s)"
	depends on WIFI_STATISTICS
	default 30
endif

config CONFIG_MM_FOREACH_DEBUG
    bool "Enable heap foreach debug"
    default n
    help
      Enable debug heap traversal in mm_foreach().
      Should be OFF in init stage to avoid crash.
```

## realprojectnewnow/vendor_allwinnertech/boards/r528/r528s3-velaevb1/Kconfig
```kconfig
#
# For a description of the syntax of this configuration file,
# see the file kconfig-language.txt in the NuttX tools repository.
#
config ARCH_BOARD_R528S3_EVB4
	bool "r528 evb4"
	depends on ARCH_CHIP_R528
	select ARCH_HAVE_LEDS
	select ARCH_HAVE_BUTTONS
	select ARCH_HAVE_IRQBUTTONS
	select ARCH_HAVE_TRUSTZONE if X4B_AP || X4B_TEE
	---help---
		This is the port of NuttX to the Allwinner A10-based pcDuino v1
		board.  See http://www.pcduino.com/ for information about pcDuino Lite, v1,
		and v2.  I have not compared these boards in detail, but I believe that
		the differences are cosmetic.  This port was developed on the v1 board,
		but the others may be compatible.

config ARCH_BOARD_PARTITION_TABLE
        string "board partition table path"
        default ""
        ---help---
                This is a path for the board.

choice
prompt "choose system fucntion"

config VELAEVB1_NSH
	bool "Enable the NSH fucntion on the 'VELAEVB1' board"

endchoice
```

## realprojectnewnow/vendor_allwinnertech/chips/r528/components/alg_cfg_test/Kconfig
```kconfig
config AW_SUNXI_ALG_CFG_TEST
	bool "Allwinner algorithm cfg test"
	depends on SND_COMMON_SUNXI_ALG_CFG
	default n
```

## realprojectnewnow/vendor_allwinnertech/chips/r528/components/audio/Kconfig
```kconfig
#
# For a description of the syntax of this configuration file,
# see the file kconfig-language.txt in the NuttX tools repository.
#

menuconfig AW_DRIVERS_AUDIO
	bool "Audio Device Support"
	default n
	---help---
		Enable support for audio device drivers.  This includes drivers for
		MP3, WMA and Ogg Vorbis encoding, decoding, as well as drivers for
		interfacing with external DSP chips to perform custom audio functions.

		NOTE: All of these drivers depend on support from the audio subsystem
		enabled with the AUDIO selection.

if AW_DRIVERS_AUDIO

config AW_AUDIO_CODEC
	bool "Support audio codec adc in R528 chip"
	default n
	depends on AUDIO
	---help---
		Select to enable support for the audiocodec by Allwinner.
		Dmic is built into the R528 chip.
		It includes no built-in support for audio CODECS
		The ADC provides:

			- Support stereo microphone input
			- Support 8~192KHz sampling rate
			- Supports 16/24bit sampling accuracy
		The DAC provides:

			- Support stereo speaker output
			- Support 8~192KHz sampling rate
			- Supports 16/24/32bit sampling accuracy

		NOTE: This driver also depends on tiny-alsa-lib support although
		that dependency is not explicit here.

if AW_AUDIO_CODEC

config AW_AUDIO_CODEC_ADC_INITVOLUME
	int "CODEC ADC init digtal volume"
	default 160
	---help---
		min value is 0, max value is 255.

config AW_AUDIO_CODEC_MSG_PRIO
	int "CODEC message priority"
	default 1

config AW_AUDIO_CODEC_BUFFER_SIZE
	int "CODEC preferred buffer size"
	default 4096

config AW_AUDIO_CODEC_NUM_BUFFERS
	int "CODEC preferred number of buffers"
	default 4

config AW_AUDIO_CODEC_WORKER_STACKSIZE
	int "CODEC worker thread stack size"
	default 2048

config AW_AUDIO_CODEC_DEFAULT_CARDNAME
	string "Default audiocodec card name"
	default "audiocodec"
	---help---
		Specifies card name for audiocodec.

endif # AW_AUDIO_CODEC


config AW_AUDIO_DMIC
	bool "Support audio dmic in R528 chip"
	default n
	depends on AUDIO
	---help---
		Select to enable support for the Dmic by Allwinner.
		Dmic is built into the R528 chip.
		It includes no built-in support for audio CODECS
		The dmic provides:

			- Support Eight digital microphone input
			- Support 8~48KHz sampling rate
			- Supports 16/24bit sampling accuracy

		NOTE: This driver also depends on tiny-alsa-lib support although
		that dependency is not explicit here.

if AW_AUDIO_DMIC

config AW_AUDIO_DMIC_MSG_PRIO
	int "DMIC message priority"
	default 1

config AW_AUDIO_DMIC_BUFFER_SIZE
	int "DMIC preferred buffer size"
	default 4096

config AW_AUDIO_DMIC_NUM_BUFFERS
	int "DMIC preferred number of buffers"
	default 4

config AW_AUDIO_DMIC_WORKER_STACKSIZE
	int "DMIC worker thread stack size"
	default 2048

config AW_AUDIO_DMIC_REGDUMP
	bool "DMIC register dump"
	default n
	select SUNXI_DMIC_DEBUG_REG
	---help---
		Enable logic to dump the contents of all DMIC registers.

config AW_AUDIO_DMIC_DEFAULT_CARDNAME
	string "Default dmic card name"
	default "snddmic"
	---help---
		Specifies card name for dmic.

endif # AW_AUDIO_AUDIO_DMIC

config AW_AUDIO_AUDIO_I2S
	bool "Audio I2S"
	depends on AUDIO
	depends on I2S

config AW_AUDIO_RPMSG_CTRL
	bool "Audio rpmsg ctrl"
	depends on AUDIO
	depends on AW_RPTUN
	---help---
		Select to enable support for the audio rpmsg by Allwinner.

		NOTE: This code is also depends on dsp rpmsg audio support although
		that dependency is not explicit here.

config AW_AUDIO_X4B_DRIVER
	bool "Audio x4b driver support"
	depends on AW_AUDIO_RPMSG_CTRL
	depends on AW_RPMSG_MEMBLK
	depends on COMPONENTS_RING_BUFFER
	---help---
		Select to enable support for the audio driver of x4b solution.


endif # AW_DRIVERS_AUDIO
```

## realprojectnewnow/vendor_allwinnertech/chips/r528/components/aw_eq/Kconfig
```kconfig
menu "Allwinner eq"

config COMPONENTS_AW_EQ
    bool "Enable AW eq"
    default y

config COMPONENTS_AW_EQ_TEST
    bool "Enable AW eq test"
    depends on COMPONENTS_AW_EQ
    default n
    help
        "Enable allwinner eq test."

endmenu
```

## realprojectnewnow/vendor_allwinnertech/chips/r528/components/bluetooth/Kconfig
```kconfig
config COMPONENTS_BLUETOOTH
	bool "Bluetooth component"
	depends on UART_BTH5 || (BLUETOOTH_BRIDGE && BLUETOOTH_SLIP)
	default n
	help
		Say y here to enable support for the bluetooth component.

if COMPONENTS_BLUETOOTH

config BLUETOOTH_LMP_SUBVER
	hex "bluetooth class of device"
	default 0x8723
	help
		bluetooth lmp subversion

config BLUETOOTH_HCI_RECV_PRIORITY
	int "bluetooth hci recv thread priority"
	default 100

config BLUETOOTH_HCI_RECV_STACKSIZE
	int "bluetooth hci recv thread stacksize"
	default 4096

config BLUETOOTH_UART_DEV
	string "the name of bluetooth uart path"
	default "/dev/uart1"
	help
		bluetooth uart bt device path

endif #COMPONENTS_BLUETOOTH
```

## realprojectnewnow/vendor_allwinnertech/chips/r528/components/libuapi/src/Kconfig
```kconfig
menu "libuapi"

config LIBUAPI
    bool "allwinner libuapi support"
        default n

endmenu
```

## realprojectnewnow/vendor_allwinnertech/chips/r528/components/multimedia/src/Kconfig
```kconfig
menuconfig MULTIMEDIA_SUPPORT
	bool "RTOS Multimedia support"
	help
	  enable rtos multimedia support, use it to implement multimedia function.

if MULTIMEDIA_SUPPORT

comment "Multimedia core support"


endif # MULTIMEDIA_SUPPORT
```
