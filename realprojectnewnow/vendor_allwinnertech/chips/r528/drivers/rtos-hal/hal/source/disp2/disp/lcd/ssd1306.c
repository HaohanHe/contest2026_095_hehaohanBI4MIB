#include "ssd1306.h"
#include <hal_gpio.h>

typedef enum {
    SPI_MASTER_OK = 0,
    SPI_MASTER_INVALID_PARAMETER = -1,
    SPI_MASTER_ERROR_BUSY = -2,
    SPI_MASTER_ERROR_TIMEOUT = -3,
    SPI_MASTER_ERROR = -4
} spi_master_status_t;

typedef enum {
    SPI_MASTER_PORT_0 = 0,
    SPI_MASTER_PORT_1 = 1,
    SPI_MASTER_PORT_2 = 2,
    SPI_MASTER_PORT_3 = 3,
    SPI_MASTER_PORT_4 = 4,
    SPI_MASTER_PORT_5 = 5
} hal_spi_master_port_t;

extern spi_master_status_t hal_spi_write(hal_spi_master_port_t port, void *buf, uint32_t size);

/* SSD1306 SPI 端口定义 */
#define SSD1306_SPI_PORT   SPI_MASTER_PORT_1
#define COMMAND 0
#define DATA    1
#define HIGH 	1
#define LOW 	0

#define RES_LEVEL(val) 	sunxi_lcd_gpio_set_value(0, 1,val)
#define DC_LEVEL(val) 	sunxi_lcd_gpio_set_value(0,0, val)
#define CS_LEVEL(val) 	sunxi_lcd_gpio_set_value(0, 4, val)
#define MOSI_LEVEL(val) sunxi_lcd_gpio_set_value(0, 2, val)
#define SCL_LEVEL(val) 	sunxi_lcd_gpio_set_value(0, 3, val)

#ifdef CONFIG_LCD_SSD1306_TEST
static u8 BMP1[];
static void oled_drawBmp(u8 x0, u8 y0,u8 x1, u8 y1,u8 BMP[]);
static void oled_set_pos(u8 x, u8 y);
#endif

static void LCD_power_on(u32 sel);
static void LCD_power_off(u32 sel);
static void LCD_bl_open(u32 sel);
static void LCD_bl_close(u32 sel);
static void LCD_panel_init(u32 sel);
static void LCD_panel_exit(u32 sel);
static void lcd_panel_ssd1306_init(u32 sel);

static void ssd1306_spi_write_byte(unsigned char data,unsigned char cmd)
{
	if(cmd)
		DC_LEVEL(HIGH);
	else
	 	DC_LEVEL(LOW);
#ifdef CONFIG_LCD_SSD1306_SPI_HW
    hal_spi_write(SSD1306_SPI_PORT, &data, 1);
#elif defined (CONFIG_LCD_SSD1306_SPI_SW)
    int i;
    CS_LEVEL(LOW);
	for (i = 0; i < 8; i++) {
		SCL_LEVEL(LOW);
		if (data & 0x80) {
			MOSI_LEVEL(HIGH);
		} else {
			MOSI_LEVEL(LOW);
		}
		data <<= 1;
		SCL_LEVEL(HIGH);
	}
	CS_LEVEL(HIGH);
#endif
}

static void LCD_cfg_panel_info(struct panel_extend_para *info){
	return;
}

static s32 LCD_open_flow(u32 sel)
{
	LCD_OPEN_FUNC(sel, LCD_power_on, 120);
	LCD_OPEN_FUNC(sel, LCD_panel_init, 100);
	LCD_OPEN_FUNC(sel, sunxi_lcd_tcon_enable, 50);
	LCD_OPEN_FUNC(sel, LCD_bl_open, 0);

	return 0;
}

static s32 LCD_close_flow(u32 sel)
{
	LCD_CLOSE_FUNC(sel, LCD_bl_close, 20);
	LCD_CLOSE_FUNC(sel, sunxi_lcd_tcon_disable, 10);
	LCD_CLOSE_FUNC(sel, LCD_panel_exit, 50);
	LCD_CLOSE_FUNC(sel, LCD_power_off, 0);
	return 0;
}

static void LCD_power_on(u32 sel)
{
	sunxi_lcd_power_enable(sel, 0);
	sunxi_lcd_delay_ms(10);
	sunxi_lcd_pin_cfg(sel, 1);
	RES_LEVEL(LOW);
	sunxi_lcd_delay_us(10);
	RES_LEVEL(HIGH);
	sunxi_lcd_delay_us(10);
	sunxi_lcd_power_enable(sel, 1);
	sunxi_lcd_delay_ms(10);
}

static void LCD_power_off(u32 sel)
{
	ssd1306_spi_write_byte(0xAE,COMMAND);
	sunxi_lcd_delay_ms(10);
	sunxi_lcd_power_disable(sel, 1);
	sunxi_lcd_delay_ms(5);
	sunxi_lcd_delay_ms(100);
	sunxi_lcd_power_disable(sel, 0);
	RES_LEVEL(LOW);
	sunxi_lcd_pin_cfg(sel, 0);
}

static void LCD_bl_open(u32 sel)
{
	sunxi_lcd_pwm_enable(sel);
	sunxi_lcd_backlight_enable(sel);
}

static void LCD_bl_close(u32 sel)
{
	sunxi_lcd_backlight_disable(sel);
	sunxi_lcd_pwm_disable(sel);
}

static void LCD_panel_init(u32 sel)
{
	lcd_panel_ssd1306_init(sel);
}

static void LCD_panel_exit(u32 sel)
{
	return;
}

static void buffer_clear(void)
{
	int i,n;
	for(i=0;i<8;i++)
	{
		ssd1306_spi_write_byte(0xb0+i,COMMAND);
		ssd1306_spi_write_byte(0x00,COMMAND);
		ssd1306_spi_write_byte(0x10,COMMAND);
		for(n=0;n<128;n++) ssd1306_spi_write_byte(0,DATA);
	}
}

static void lcd_panel_ssd1306_init(u32 sel)
{
	ssd1306_spi_write_byte(0xA8,COMMAND);
	ssd1306_spi_write_byte(0x3F,COMMAND);
	ssd1306_spi_write_byte(0xD3,COMMAND);
	ssd1306_spi_write_byte(0x00,COMMAND);
	ssd1306_spi_write_byte(0x40,COMMAND);
	ssd1306_spi_write_byte(0xA1,COMMAND);
	ssd1306_spi_write_byte(0xC8,COMMAND);
	ssd1306_spi_write_byte(0xDA,COMMAND);
	ssd1306_spi_write_byte(0x12,COMMAND);
	ssd1306_spi_write_byte(0x81,COMMAND);
	ssd1306_spi_write_byte(0x7F,COMMAND);
	ssd1306_spi_write_byte(0xA4,COMMAND);
	ssd1306_spi_write_byte(0xA6,COMMAND);
	ssd1306_spi_write_byte(0xD5,COMMAND);
	ssd1306_spi_write_byte(0x80,COMMAND);
	ssd1306_spi_write_byte(0x8D,COMMAND);
	ssd1306_spi_write_byte(0x14,COMMAND);
	ssd1306_spi_write_byte(0xAF,COMMAND);
	buffer_clear();
#ifdef CONFIG_LCD_SSD1306_TEST
	oled_drawBmp(0,0,128,8,BMP1);
#endif
	sunxi_lcd_delay_ms(100);
}

struct __lcd_panel ssd1306_panel = {
	.name = "ssd1306",
	.func = {
		.cfg_panel_info = LCD_cfg_panel_info,
		.cfg_open_flow = LCD_open_flow,
		.cfg_close_flow = LCD_close_flow,
	},
};

#ifdef CONFIG_LCD_SSD1306_TEST
static void oled_set_pos(u8 x, u8 y)
{
	ssd1306_spi_write_byte(0xb0+y,COMMAND);
	ssd1306_spi_write_byte(((x&0xf0)>>4)|0x10,COMMAND);
	ssd1306_spi_write_byte((x&0x0f)|0x01,COMMAND);
}

static void oled_drawBmp(u8 x0, u8 y0,u8 x1, u8 y1,u8 BMP[])
{
 int j=0;
 int x,y;

  if(y1%8==0) y=y1/8;
  else y=y1/8+1;
	for(y=y0;y<y1;y++)
	{
		oled_set_pos(x0,y);
    	for(x=x0;x<x1;x++)
			ssd1306_spi_write_byte(BMP[j++],DATA);
	}
}

static u8 BMP1[] =
{
	0x00,0x03,0x05,0x09,0x11,0xFF,0x11,0x89,0x05,0xC3,0x00,0xE0,0x00,0xF0,0x00,0xF8,
	0x00,0x00,0x00,0x00,0x00,0x00,0x00,0x44,0x28,0xFF,0x11,0xAA,0x44,0x00,0x00,0x00,
	0x00,0x00,0x00,0x00,0x00,0x00,0x00,0x00,0x00,0x00,0x00,0x00,0x00,0x00,0x00,0x00,
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	0x00,0x00,0x26,0x49,0x49,0x49,0x32,0x00,0x00,0x7F,0x02,0x04,0x08,0x10,0x7F,0x00,
};
#endif