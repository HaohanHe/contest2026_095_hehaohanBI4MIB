/* Copyright (c) 2019-2025 Allwinner Technology Co., Ltd. ALL rights reserved.

 * Allwinner is a trademark of Allwinner Technology Co.,Ltd., registered in
 * the the People's Republic of China and other countries.
 * All Allwinner Technology Co.,Ltd. trademarks are used with permission.

 * DISCLAIMER
 * THIRD PARTY LICENCES MAY BE REQUIRED TO IMPLEMENT THE SOLUTION/PRODUCT.
 * IF YOU NEED TO INTEGRATE THIRD PARTY’S TECHNOLOGY (SONY, DTS, DOLBY, AVS OR MPEGLA, ETC.)
 * IN ALLWINNERS’SDK OR PRODUCTS, YOU SHALL BE SOLELY RESPONSIBLE TO OBTAIN
 * ALL APPROPRIATELY REQUIRED THIRD PARTY LICENCES.
 * ALLWINNER SHALL HAVE NO WARRANTY, INDEMNITY OR OTHER OBLIGATIONS WITH RESPECT TO MATTERS
 * COVERED UNDER ANY REQUIRED THIRD PARTY LICENSE.
 * YOU ARE SOLELY RESPONSIBLE FOR YOUR USAGE OF THIRD PARTY’S TECHNOLOGY.


 * THIS SOFTWARE IS PROVIDED BY ALLWINNER"AS IS" AND TO THE MAXIMUM EXTENT
 * PERMITTED BY LAW, ALLWINNER EXPRESSLY DISCLAIMS ALL WARRANTIES OF ANY KIND,
 * WHETHER EXPRESS, IMPLIED OR STATUTORY, INCLUDING WITHOUT LIMITATION REGARDING
 * THE TITLE, NON-INFRINGEMENT, ACCURACY, CONDITION, COMPLETENESS, PERFORMANCE
 * OR MERCHANTABILITY AND FITNESS FOR A PARTICULAR PURPOSE.
 * IN NO EVENT SHALL ALLWINNER BE LIABLE FOR ANY DIRECT, INDIRECT, INCIDENTAL,
 * SPECIAL, EXEMPLARY, OR CONSEQUENTIAL DAMAGES (INCLUDING, BUT
 * NOT LIMITED TO, PROCUREMENT OF SUBSTITUTE GOODS OR SERVICES;
 * LOSS OF USE, DATA, OR PROFITS, OR BUSINESS INTERRUPTION)
 * HOWEVER CAUSED AND ON ANY THEORY OF LIABILITY, WHETHER IN CONTRACT,
 * STRICT LIABILITY, OR TORT (INCLUDING NEGLIGENCE OR OTHERWISE)
 * ARISING IN ANY WAY OUT OF THE USE OF THIS SOFTWARE, EVEN IF ADVISED
 * OF THE POSSIBILITY OF SUCH DAMAGE.
 */

#include "gc9503cv.h"

static void lcd_power_on(u32 sel);
static void lcd_power_off(u32 sel);
static void lcd_bl_open(u32 sel);
static void lcd_bl_close(u32 sel);

static void lcd_panel_init(u32 sel);
static void lcd_panel_exit(u32 sel);

#define panel_reset(sel, val) sunxi_lcd_gpio_set_value(sel, 0, val)

static void lcd_cfg_panel_info(struct panel_extend_para *info)
{
	u32 i = 0, j = 0;
	u32 items;
	u8 lcd_gamma_tbl[][2] = {
		{0, 0},
		{15, 15},
		{30, 30},
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		{255, 255},
	};

	u32 lcd_cmap_tbl[2][3][4] = {
		{
			{LCD_CMAP_G0, LCD_CMAP_B1, LCD_CMAP_G2, LCD_CMAP_B3},
			{LCD_CMAP_B0, LCD_CMAP_R1, LCD_CMAP_B2, LCD_CMAP_R3},
			{LCD_CMAP_R0, LCD_CMAP_G1, LCD_CMAP_R2, LCD_CMAP_G3},
		},
		{
			{LCD_CMAP_B3, LCD_CMAP_G2, LCD_CMAP_B1, LCD_CMAP_G0},
			{LCD_CMAP_R3, LCD_CMAP_B2, LCD_CMAP_R1, LCD_CMAP_B0},
			{LCD_CMAP_G3, LCD_CMAP_R2, LCD_CMAP_G1, LCD_CMAP_R0},
		},
	};

	items = sizeof(lcd_gamma_tbl) / 2;
	for (i = 0; i < items - 1; i++) {
		u32 num = lcd_gamma_tbl[i + 1][0] - lcd_gamma_tbl[i][0];

		for (j = 0; j < num; j++) {
			u32 value = 0;

			value = lcd_gamma_tbl[i][1] +
				((lcd_gamma_tbl[i + 1][1] - lcd_gamma_tbl[i][1])
				 * j) / num;
			info->lcd_gamma_tbl[lcd_gamma_tbl[i][0] + j] =
				(value << 16)
				+ (value << 8) + value;
		}
	}
	info->lcd_gamma_tbl[255] = (lcd_gamma_tbl[items - 1][1] << 16) +
				   (lcd_gamma_tbl[items - 1][1] << 8)
				   + lcd_gamma_tbl[items - 1][1];

	memcpy(info->lcd_cmap_tbl, lcd_cmap_tbl, sizeof(lcd_cmap_tbl));

}

static void lcd_panel_try_switch(u32 sel)
{
	u8 result[16] = {0};
	u32 num;
	sunxi_lcd_dsi_dcs_read(sel, 0x04, result, &num);
	syslog(LOG_INFO, "get lcd id 0x%x, 0x%x, 0x%x\n", result[0], result[1], result[2]);
	if (result[0] != 0x31)
		sunxi_lcd_switch_compat_panel(sel, 1);
}

static s32 lcd_open_flow(u32 sel)
{
	LCD_OPEN_FUNC(sel, lcd_power_on, 10);
	LCD_OPEN_FUNC(sel, lcd_panel_init, 10);
	LCD_OPEN_FUNC(sel, sunxi_lcd_tcon_enable, 60);
	LCD_OPEN_FUNC(sel, lcd_bl_open, 0);

	return 0;
}

static s32 lcd_close_flow(u32 sel)
{
	LCD_CLOSE_FUNC(sel, lcd_bl_close, 0);
	LCD_CLOSE_FUNC(sel, sunxi_lcd_tcon_disable, 0);
	LCD_CLOSE_FUNC(sel, lcd_panel_exit, 200);
	LCD_CLOSE_FUNC(sel, lcd_power_off, 500);

	return 0;
}

static void lcd_power_on(u32 sel)
{
	panel_reset(sel, 1);
	sunxi_lcd_delay_ms(10);
	panel_reset(sel, 0);
	sunxi_lcd_delay_ms(10);
	panel_reset(sel, 1);
	sunxi_lcd_delay_ms(30);
	sunxi_lcd_pin_cfg(sel, 1);
	lcd_panel_try_switch(sel);
}

static void lcd_power_off(u32 sel)
{
	sunxi_lcd_pin_cfg(sel, 0);
	sunxi_lcd_delay_ms(20);
	panel_reset(sel, 1);
	sunxi_lcd_delay_ms(10);
}

static void lcd_bl_open(u32 sel)
{
	sunxi_lcd_pwm_enable(sel);
}

static void lcd_bl_close(u32 sel)
{
	sunxi_lcd_pwm_disable(sel);
}

#define REGFLAG_DELAY 0XFC
#define REGFLAG_END_OF_TABLE 0xFD /* END OF REGISTERS MARKER */

struct LCM_setting_table {
	u8 cmd;
	u32 count;
	u8 para_list[120];
};

static struct LCM_setting_table lcm_gc9503cv_setting[] = {
	{0xF0, 5, {0x55, 0xAA, 0x52, 0x08, 0x00}},
	{0xF6, 2, {0x5A, 0x87}},
	{0xC1, 1, {0x3F}},
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	{0xD6, 52, {0x00,0x00,0x00,0x2f,0x00,0x4f,0x00,0x78,0x00,0x9c,0x00,0xd0,0x00,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0x03,0xFF}},

	{0x11, 0, {}},
	{REGFLAG_DELAY, REGFLAG_DELAY, {120}},
	{0x6D, 32, {0x1E, 0x10, 0x0E, 0x0C, 0x0A, 0x1E, 0x02, 0x1E, 0x19, 0x1E, 0x1A, 0x1E, 0x1E, 0x1E, 0x1E, 0x1E, 0x1E, 0x1E, 0x1E, 0x1E, 0x1E, 0x1A, 0x1E, 0x19, 0x1E, 0x01, 0x1E, 0x09, 0x0B, 0x0D, 0x0F, 0x1E}},
	{0x77, 2, {0x00, 0x00}},
	{0xA6, 1, {0x56}},
	{0x29, 0, {}},
	{REGFLAG_DELAY, REGFLAG_DELAY, {120}},
	{REGFLAG_END_OF_TABLE, REGFLAG_END_OF_TABLE, {}}
};

static struct LCM_setting_table lcm_gc9503cv_sleep_setting[] = {
	{0xF0,5,{0x55,0xaa,0x52,0x08,0x00}}, // 20200403   james
	{0xc1, 1,{0x3f}},  // reg en 6c  20200403    james
	{0x6C, 1,{0x60}},
	{REGFLAG_DELAY, REGFLAG_DELAY, {20}},
	{0xB1, 1,{0x00}},
	{0xFA, 4,{0x7F, 0x00, 0x00, 0x00}},
	{REGFLAG_DELAY, REGFLAG_DELAY, {20}},
	{0x6c,1,{0x50}},
	{REGFLAG_DELAY, REGFLAG_DELAY, {10}},

	{0x28, 0,{0x00}},
	{REGFLAG_DELAY, REGFLAG_DELAY, {50}},
	{0x10, 0,{0x00}},
	{REGFLAG_DELAY, REGFLAG_DELAY, {20}},

         //下电代码
	{0xF0,5,{0x55,0xaa,0x52,0x08,0x00}},
	{0xc2,1,{0xce}},
	{0xc3,1,{0xcd}},
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	{0xaf,1,{0x02}},

	{REGFLAG_END_OF_TABLE, REGFLAG_END_OF_TABLE, {}}
};

static void lcd_panel_init(u32 sel)
{
	__u32 i;
	syslog(LOG_DEBUG, "lcd_panel_init\n");
	sunxi_lcd_dsi_clk_enable(sel);
	for (i = 0;; i++) {
		if (lcm_gc9503cv_setting[i].count == REGFLAG_END_OF_TABLE)
			break;
		else if (lcm_gc9503cv_setting[i].count == REGFLAG_DELAY) {
			sunxi_lcd_delay_ms(lcm_gc9503cv_setting[i].para_list[0]);
		} else {
			dsi_dcs_wr(sel, lcm_gc9503cv_setting[i].cmd,
				   lcm_gc9503cv_setting[i].para_list,
				   lcm_gc9503cv_setting[i].count);
		}
	}
}

static void lcd_panel_exit(u32 sel)
{
	__u32 i;
	for (i = 0;; i++) {
		if (lcm_gc9503cv_sleep_setting[i].count == REGFLAG_END_OF_TABLE)
			break;
		else if (lcm_gc9503cv_sleep_setting[i].count == REGFLAG_DELAY) {
			sunxi_lcd_delay_ms(lcm_gc9503cv_sleep_setting[i].para_list[0]);
		} else {
			dsi_dcs_wr(sel, lcm_gc9503cv_sleep_setting[i].cmd,
				   lcm_gc9503cv_sleep_setting[i].para_list,
				   lcm_gc9503cv_sleep_setting[i].count);
		}
	}
}

/*sel: 0:lcd0; 1:lcd1*/
static s32 lcd_user_defined_func(u32 sel, u32 para1, u32 para2, u32 para3)
{
	return 0;
}

struct __lcd_panel gc9503cv_panel = {
	/* panel driver name, must mach the name of
	 * lcd_drv_name in sys_config.fex
	 */
	.name = "gc9503cv",
	.func = {
		.cfg_panel_info = lcd_cfg_panel_info,
		.cfg_open_flow = lcd_open_flow,
		.cfg_close_flow = lcd_close_flow,
		.lcd_user_defined_func = lcd_user_defined_func,
	},
};
