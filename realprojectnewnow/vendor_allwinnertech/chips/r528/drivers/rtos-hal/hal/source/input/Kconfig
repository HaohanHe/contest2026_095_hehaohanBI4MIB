## realprojectnewnow/vendor_allwinnertech/chips/r528/drivers/rtos-hal/hal/source/input/Kconfig
```kconfig
menu "Input device dirvers"
source '../vendor/allwinnertech/chips/r528/drivers/rtos-hal/hal/source/input/tp/Kconfig'
endmenu
```

## realprojectnewnow/vendor_allwinnertech/chips/r528/drivers/rtos-hal/hal/source/input/tp/Kconfig
```kconfig
menuconfig DRIVERS_TP
	bool "touch panel devices"
source '../vendor/allwinnertech/chips/r528/drivers/rtos-hal/hal/source/input/tp/tlsc6x/Kconfig'
```

## realprojectnewnow/vendor_allwinnertech/chips/r528/drivers/rtos-hal/hal/source/input/tp/tlsc6x/Kconfig
```kconfig
if DRIVERS_TP
config DRIVERS_TLSC6X
	select DRIVERS_TWI
	select INPUT_TOUCHSCREEN
	bool "tlsc6x tp driver"
	default n
	---help---
		Select to enable support touch panel tlsc6x
endif
```

## realprojectnewnow/vendor_allwinnertech/chips/r528/drivers/rtos-hal/hal/source/msgbox/Kconfig
```kconfig
menu "Message Box Devices"

config DRIVERS_MSGBOX
	bool "enable Message Box driver"
		default n

config HAL_TEST_MSGBOX
	bool "enable msgbox hal APIs test command"
		depends on DRIVERS_MSGBOX
		default n
endmenu
```

## realprojectnewnow/vendor_allwinnertech/chips/r528/drivers/rtos-hal/hal/source/nand_flash/Kconfig
```kconfig
menu "Nand Flash Devices"

config DRIVERS_NAND_FLASH
    bool "enable nand flash driver"
        default n

config NAND_FLASH_DEBUG
    bool "enable nand flash debug log"
    depends on DRIVERS_NAND_FLASH
        default n

endmenu
```

## realprojectnewnow/vendor_allwinnertech/chips/r528/drivers/rtos-hal/hal/source/pwm/Kconfig
```kconfig
menu "PWM Devices"

config DRIVERS_PWM
    bool "enable pwm driver"
        default n

config HAL_TEST_PWM
    bool "enable pwm hal APIs test command"
    depends on DRIVERS_PWM
        default n

endmenu
```

## realprojectnewnow/vendor_allwinnertech/chips/r528/drivers/rtos-hal/hal/source/sdmmc/Kconfig
```kconfig
menu "SDMMC Devices"

config DRIVERS_SDMMC
    bool "enable SDMMC drivers"
        default n

if DRIVERS_SDMMC

config USE_SDMMC_MULT
	bool "enable SD_MULT"
	default n

config USE_SD
	bool "enable SD"
	default n

config USE_SDIO
	bool "enable SDIO"
	default n
	select ARCH_HAVE_SDIO

config USE_MMC
	bool "enable mmc"
	default n

config eMMC_SUPPORT_SUN20IW2
	bool "enable emmc for r128/xr875"
	select USE_MMC
	default n

config DETECT_CARD
	bool "enable detect card"
	default n

config SDC_DMA_USED
	bool "enable dma transmission"
	default y
	select SDIO_DMA

config SDIO_IRQ_SUPPORT
	bool "enable sdio irq"
	default n

config SD_TEST
	select USE_SD
	bool "enable SD Card test case."
	default n

config SDC_DMA_BUF_SIZE
	int "SD Card Align DMA Buffer Size(Kbyte)."
	depends on SDC_DMA_USED
	default 64

config DRIVERS_SDC_CDPIN_PRESENT_VAL
	int "sdc card detect pin present value"
	default 0

config DRIVERS_SDMMC_FS
	bool "support SDMMC filesystem"
	select COMPONENT_ELMFAT
	default n

config HAL_TEST_SDMMC
    bool "enable dma hal APIs test command"
	depends on DRIVERS_DMA
        default n

endif
endmenu
```

## realprojectnewnow/vendor_allwinnertech/chips/r528/drivers/rtos-hal/hal/source/sensor/Kconfig
```kconfig
menu "Sensor Devices"

config SENSORS_HX3203
        bool "HX3203 Ambient Light Sensor for uORB"
        default n
        select DRIVERS_TWI
        ---help---
                Enable support for the HX3203 Ambient Light Sensor driver.

config SENSORS_SHTC3
        bool "SHTC3 Temperature & Humidity Sensor"
        default n
        select DRIVERS_TWI
        ---help---
                Enable support for the SHTC3 Temperature & Humidity Sensor driver.

config SENSORS_LTR553
    bool "LTR553 Ambient Light and Proximity Sensor"
    default n
    depends on I2C
    ---help---
        Enable driver for LTR553 ambient light and proximity sensor.

config SENSORS_SGP30_UORB
    bool "SGP30 co2 and tvoc UORB Sensor"
    default n
    select DRIVERS_TWI
    depends on I2C
    ---help---
        Enable driver for SGP30 co2 and tvoc sensor.

if SENSORS_LTR553
config LTR553_I2C_FREQUENCY
    int "LTR553 I2C frequency"
    default 400000
    range 1 400000
endif # SENSORS_LTR553
endmenu
```

## realprojectnewnow/vendor_allwinnertech/chips/r528/drivers/rtos-hal/hal/source/sound/Kconfig
```kconfig
menu "SOUND Devices"

config DRIVERS_SOUND
	bool "Sound card support"
	default n

if DRIVERS_SOUND
source '../vendor/allwinnertech/chips/r528/drivers/rtos-hal/hal/source/sound/core/Kconfig'
source '../vendor/allwinnertech/chips/r528/drivers/rtos-hal/hal/source/sound/codecs/Kconfig'
source '../vendor/allwinnertech/chips/r528/drivers/rtos-hal/hal/source/sound/platform/Kconfig'
source '../vendor/allwinnertech/chips/r528/drivers/rtos-hal/hal/source/sound/component/Kconfig'
source '../vendor/allwinnertech/chips/r528/drivers/rtos-hal/hal/source/sound/common/Kconfig'

endif # DRIVERS_SOUND

endmenu
```

## realprojectnewnow/vendor_allwinnertech/chips/r528/drivers/rtos-hal/hal/source/sound/codecs/Kconfig
```kconfig
menu "AllWinner CODEC drivers"

config SND_CODEC_SUN8IW20_AUDIOCODEC
	bool "Allwinner AudioCodec support"
	default n
	select SND_PLATFORM_SUNXI_CPUDAI
	select SND_PLATFORM_SUNXI_PCM
	depends on (SOC_SUN20IW1P1 || ARCH_SUN8IW20)
	help
	  Select Y to add support the Codec embedded in the Allwinner
	  sun8iw20 and affiliated SoCs.

config SND_CODEC_DUMMY
	bool "Sunxi dummy codec"
	default n


endmenu
```

## realprojectnewnow/vendor_allwinnertech/chips/r528/drivers/rtos-hal/hal/source/twi/Kconfig
```kconfig
menu "TWI Devices"

config DRIVERS_TWI
    bool "enable twi driver"
    depends on I2C
        default n

config HAL_TEST_TWI
    bool "enable twi hal APIs test command"
    depends on DRIVERS_TWI
        default n

endmenu
```

## 国际空间通信挑战赛项目规划/vendor_allwinnertech/boards/r528/r528s3-evb4/Kconfig
```kconfig
#
# For a description of the syntax of this configuration file,
# see the file kconfig-language.txt in the NuttX tools repository.
#
config ARCH_BOARD_R528S3_EVB4
	bool "r528 evb4"
	depends on ARCH_CHIP_R528
	select ARCH_HAVE_LEDS
	select ARCH_HAVE_BUTTONS
	select ARCH_HAVE_IRQBUTTONS
	select ARCH_HAVE_TRUSTZONE if X4B_AP || X4B_TEE
	---help---
		This is the port of NuttX to the Allwinner A10-based pcDuino v1
		board.  See http://www.pcduino.com/ for information about pcDuino Lite, v1,
		and v2.  I have not compared these boards in detail, but I believe that
		the differences are cosmetic.  This port was developed on the v1 board,
		but the others may be compatible.

config ARCH_BOARD_PARTITION_TABLE
        string "board partition table path"
        default ""
        ---help---
                This is a path for the board.

choice
prompt "choose system fucntion"

config X4B_BL
	bool "Enable the BOOTLOADER fucntion on the 'X4B' board"

config X4B_TEE
	bool "Enable the TEE fucntion on the 'X4B' board"
if X4B_TEE
config X4B_TEE_AVB_ROLLBACK_INDEX
	int "TEE AVB rollback index"
	default 0
endif

config X4B_OTA
	bool "Enable the OTA fucntion on the 'X4B' board"
if X4B_OTA
config X4B_OTA_AVB_ROLLBACK_INDEX
	int "OTA AVB rollback index"
	default 0
endif

config X4B_AP
	bool "Enable the AP fucntion on the 'X4B' board"
if X4B_AP
config X4B_AP_AVB_ROLLBACK_INDEX
	int "AP AVB rollback index"
	default 0
endif

config X4B_FACTEST
        bool "Enable the FACTEST fucntion on the 'X4B' board"

endchoice

config X4B_NO_VERIFY
	bool "Boot tee directly without verify"
	default n
	depends on X4B_BL
```
